## components/third_party/nmea0183_parser/Kconfig
```kconfig
menu "NMEA parser configuration"

config NMEA_PARSER_RING_BUFFER_SIZE
    int "NMEA parser ring buffer size"
    default 2048
    help
        Size of the UART RX ring buffer used by the parser. A larger buffer
        tolerates bursts of incoming NMEA sentences without loss.

config NMEA_PARSER_TASK_STACK_SIZE
    int "NMEA parser task stack size"
    default 4096

config NMEA_PARSER_TASK_PRIORITY
    int "NMEA parser task priority"
    default 12

config NMEA_PARSER_UART_RXD
    int "NMEA parser UART RX pin"
    default 34

config NMEA_STATEMENT_GGA
    bool "Enable GGA statement parsing"
    default y

config NMEA_STATEMENT_GSA
    bool "Enable GSA statement parsing"
    default y

config NMEA_STATEMENT_GSV
    bool "Enable GSV statement parsing"
    default y

config NMEA_STATEMENT_RMC
    bool "Enable RMC statement parsing"
    default y

config NMEA_STATEMENT_GLL
    bool "Enable GLL statement parsing"
    default y

config NMEA_STATEMENT_VTG
    bool "Enable VTG statement parsing"
    default y

endmenu
```

## main/Kconfig.projbuild
```kconfig
# TODO: Can we remove the MCU choice? 

menu "Atlas Configuration"
    choice ATLAS_MCU
        bool "Target MCU"

        config ATLAS_MCU_ESP32S3_WROOM
            bool "ESP32-S3 WROOM"

        config ATLAS_MCU_ARDUINO_ESP32
            bool "Arduino Nano ESP32"
    endchoice

    choice COMPILE_BOARD
        prompt "Target Board"

        config COMPILE_BOARD_MANNY
            bool "Manny"
            help
                Manny flight computer board.
    endchoice

    config INSTALL_USB_JTAG_DRIVER
        bool "Install USB Serial/JTAG driver"
        default n
        help
            Set to false if no device is connected and able to consume JTAG I/O.

endmenu

menu "Ground Services Configuration"

    config GROUND_SERVICES_AUTH_TOKEN
        string "Ground Services HMAC shared secret"
        default "CHANGE_ME_GROUND_SERVICES_TOKEN"
        help
            Shared secret used to sign safety-critical Ground Services requests.
            This is separate from the WiFi SoftAP password.
            Do not commit real tokens. Set the private value with
            idf.py menuconfig; ESP-IDF writes it to sdkconfig, which is ignored.

endmenu

menu "Rocket Access Point Configuration"

    config ROCKET_AP_SSID
        string "Rocket SoftAP SSID"
        default "Aurora AP"
        help
            SoftAP network name advertised by the board.
            Change local values with idf.py menuconfig; ESP-IDF writes them to
            sdkconfig, which is ignored.

    config ROCKET_AP_PASSWORD
        string "Rocket SoftAP password"
        default "CHANGE_ME_ROCKET_AP_PASSWORD"
        help
            Non-empty passwords must be at least 8 characters.
            Do not commit real passwords. Set the private value with
            idf.py menuconfig; ESP-IDF writes it to sdkconfig, which is ignored.

    config ROCKET_AP_ALLOW_OPEN_DEVELOPMENT
        bool "Allow an open SoftAP for development"
        default n
        help
            Explicit development-only escape hatch. Operational builds leave
            this disabled and require a WPA2 password of at least 8 characters.

    config ROCKET_AP_CHANNEL
        int "Rocket SoftAP channel"
        default 1
        range 1 13
        help
            WiFi channel used by the board SoftAP.
            Change local values with idf.py menuconfig; ESP-IDF writes them to
            sdkconfig, which is ignored.

    config ROCKET_AP_MAX_CONNECTIONS
        int "Rocket SoftAP maximum station connections"
        default 4
        range 1 4
        help
            Maximum number of stations allowed to connect to the board SoftAP.
            Change local values with idf.py menuconfig; ESP-IDF writes them to
            sdkconfig, which is ignored.

    config ROCKET_AP_IP_ADDR
        string "Rocket SoftAP static IP address"
        default "192.168.4.1"
        help
            Static IPv4 address assigned to the board SoftAP interface.
            Change local values with idf.py menuconfig; ESP-IDF writes them to
            sdkconfig, which is ignored.

    config ROCKET_AP_NETMASK
        string "Rocket SoftAP netmask"
        default "255.255.255.0"
        help
            IPv4 netmask used by the board SoftAP interface.
            Change local values with idf.py menuconfig; ESP-IDF writes them to
            sdkconfig, which is ignored.

endmenu

menu "Aurora Hil Configuration"
    # config AURORA_HIL_SIMULATION
    #     bool "Enable Hardware-in-the-Loop simulation mode"
    #     default n
    #     help
    #         Enables the HIL simulation task. In this mode the firmware
    #         receives simulated sensor data from the simulator and sends
    #         commands back to the simulator.

    config AURORA_HIL_SUPPORT
        bool "Add feature Hardware-in-the-Loop simulation"
        default n
        help
            Add support for the Hardware-In-the-Loop simulation.

    if AURORA_HIL_SUPPORT

    config AURORA_HIL_SERVER_PORT
        int "HIL TCP server port"
        default 5000
        range 1024 65535
        help
            TCP port used by the HIL simulation server running on the ESP32.

    endif

endmenu
```
